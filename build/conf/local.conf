## build/conf/local.conf
```bitbake
# Use this to specify where BitBake should place the downloaded sources
DL_DIR = "${TOPDIR}/oe_sources/"

BBFILES = "${TOPDIR}/recipes/*/*.bb"

# Use the BBMASK below to instruct BitBake to _NOT_ consider some .bb files
# This is a regular expression, so be sure to get your parentheses balanced.
BBMASK = ""

# Select between multiple alternative providers, if more than one is eligible.
PREFERRED_PROVIDERS = "virtual/qte:qte virtual/libqpe:libqpe-opie"
PREFERRED_PROVIDERS += " virtual/libsdl:libsdl-x11"
PREFERRED_PROVIDERS += " virtual/${TARGET_PREFIX}gcc-initial:gcc-cross-initial"
PREFERRED_PROVIDERS += " virtual/${TARGET_PREFIX}gcc-intermediate:gcc-cross-intermediate"
PREFERRED_PROVIDERS += " virtual/${TARGET_PREFIX}gcc:gcc-cross"
PREFERRED_PROVIDERS += " virtual/${TARGET_PREFIX}g++:gcc-cross"

MACHINE ?= "at91sam9g20ek"

DISTRO = "angstrom-2008.1"

DISTRO_SSH_DAEMON = "openssh"

IMAGE_FSTYPES = "jffs2 tar.bz2"

IMAGE_KEEPROOTFS = "1"

PARALLEL_MAKE = "-j 4"

BB_NUMBER_THREADS = "2"

BBINCLUDELOGS = "yes"

# To save space
INHERIT += "rm_work"

# Cache values of all SRCREV variables first time it runs
BB_SRCREV_POLICY = "cache"

DISTRO_FEATURES_local = "largefile ipv4 ipv6 nfs smbfs wifi ppp alsa bluetooth ext2 vfat irda pcmcia usbgadget usbhost pci pam thumb-interwork thumb-interwork"
```
